// SPDX-License-Identifier: GPL-2.0-or-later OR MIT 

#include "mt7981b-zbt-z8105ax.dtsi"

/ {
	model = "ZBT Z8105AX";
	compatible = "z8105ax", "z8105ax", "mediatek,mt7981";
};

&nand_rootfs {
	reg = <0x0580000 0x7E80000>;
};

